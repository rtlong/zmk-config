#include <behaviors.dtsi>
#include <dt-bindings/zmk/keys.h>
#include <dt-bindings/zmk/bt.h>

#define TAPPING_TERM 264 // number from my ZSA config (shocking how a few tens of ms can make a difference!)

#define SEND_KEY_TWICE_MACRO(NAME, KEY) \
/ { \
  macros { \
    ZMK_MACRO(NAME, \
        wait-ms = <40>; \
        tap-ms = <40>; \
        bindings = <&kp KEY &kp KEY>; \
    ) \
  }; \
  behaviors { \
    ht_##NAME: ht_##NAME { \
        compatible = "zmk,behavior-hold-tap"; \
        label = "HT_##NAME"; \
        #binding-cells = <2>; \
        tapping-term-ms = <TAPPING_TERM>; \
        quick-tap-ms = <0>; \
        flavor = "tap-preferred"; \
        bindings = <&kp>, <&NAME>; \
    }; \
  }; \
};

// FIXME: &ht_dollar_dollar is sending SPACE instead of DOLLAR
SEND_KEY_TWICE_MACRO(dollar_dollar, DOLLAR)

SEND_KEY_TWICE_MACRO(space_space, SPACE)

// key aliases to keep keymap layout neater
#define CT(x) &cmd_hold LG(x) x
#define OT(x) &cmd_hold LA(x) x

#define MEH      LA(LC(LSHIFT))
#define PREV_TAB LC(LS(TAB))
#define NEXT_TAB LC(TAB)
#define BACK     LG(LBKT)
#define FORWARD  LG(RBKT)

#define BSLH_HOME &ht_tp HOME        BACKSLASH
#define PIPE_END  &ht_tp END         PIPE
#define ESC_FQUIT &ht_tp LA(LG(ESC)) ESC
#define Q_H       &ht_tp H           Q
#define DEL_CTR_K &ht_tp LC(K)       DEL
#define SPC_OPEN  &ht_tp LG(O)       SPACE

// layers
#define SYMBOLS 1
#define NUMBERS 2
#define NAVIGATE 3
#define HARDWARE 4

&mt {
    tapping-term-ms = <TAPPING_TERM>;
};
&lt {
    tapping-term-ms = <TAPPING_TERM>;
};
&sk {
    quick-release;
};

/ {
    behaviors {
        ht_tp: hold_tap_tap_preferred {
            compatible = "zmk,behavior-hold-tap";
            label = "HT_TP";
            #binding-cells = <2>;
            tapping-term-ms = <TAPPING_TERM>;
            quick-tap-ms = <0>;
            flavor = "tap-preferred";
            bindings = <&kp>, <&kp>;
        };

        cmd_hold: command_hold {
            compatible = "zmk,behavior-hold-tap";
            label = "CMD_HOLD";
            #binding-cells = <2>;
            tapping-term-ms = <TAPPING_TERM>;
            quick-tap-ms = <0>;
            flavor = "tap-preferred";
            bindings = <&kp>, <&kp>;
        };

        td_spc: tap_dance_space {
            compatible = "zmk,behavior-tap-dance";
            label = "TAP_DANCE_SPC";
            #binding-cells = <0>;
            tapping-term-ms = <TAPPING_TERM>;
            bindings = <&ht_tp LCMD SPACE>, <&ht_space_space LG(SPACE) 0>;
        };

        td_q: tap_dance_esc {
            compatible = "zmk,behavior-tap-dance";
            label = "TAP_DANCE_Q";
            #binding-cells = <0>;
            tapping-term-ms = <TAPPING_TERM>;
            bindings = <&kp Q>, <&cmd_hold LG(Q) ESC>;
        };

        td_prscr: tap_dance_screenshot {
            compatible = "zmk,behavior-tap-dance";
            label = "TAP_DANCE_PRSCR";
            #binding-cells = <0>;
            tapping-term-ms = <TAPPING_TERM>;
            bindings = <&cmd_hold LC(LG(LS(N4))) DOLLAR>, <&ht_dollar_dollar LG(LS(N5)) 0>;
        };
    };

    keymap {
        compatible = "zmk,keymap";
        default_layer { // 0
            bindings = \
//       ╭─────────────┬─────────────┬─────────────┬─────────────┬─────────────╮   ╭─────────────┬─────────────┬─────────────┬─────────────┬─────────────╮
<&none     &td_q         CT(W)         CT(F)         CT(P)         CT(B)             CT(J)         CT(L)         CT(U)         CT(Y)         CT(BSPC)      &none >,
//       ├─────────────┼─────────────┼─────────────┼─────────────┼─────────────┤   ├─────────────┼─────────────┼─────────────┼─────────────┼─────────────┤
<&none     CT(A)         CT(R)         CT(S)         CT(T)         CT(G)             CT(M)         CT(N)         CT(E)         CT(I)         CT(O)         &none >,
//       ├─────────────┼─────────────┼─────────────┼─────────────┼─────────────┤   ├─────────────┼─────────────┼─────────────┼─────────────┼─────────────┤
<&none     CT(Z)         CT(X)         CT(C)         CT(D)         CT(V)             CT(K)         CT(H)         CT(COMMA)     CT(DOT)       CT(FSLH)      &none >,
//       ╰─────────────┴─────────────┼─────────────┼─────────────┼─────────────┤   ├─────────────┼─────────────┼─────────────┼─────────────┴─────────────╯
<                                      &kp MEH       &td_spc       &kp LSHIFT        &sk LALT      &sl SYMBOLS   &sk RCTRL     >;
//                                   ╰─────────────┴─────────────┴─────────────╯   ╰─────────────┴─────────────┴─────────────╯
        };

        symbols_layer { // SYMBOLS (one-shot)
            bindings = \
//       ╭─────────────┬─────────────┬─────────────┬─────────────┬─────────────╮   ╭─────────────┬─────────────┬─────────────┬─────────────┬─────────────╮
<&none     &kp ESC       &kp AT        &kp HASH      &td_prscr     &kp PRCNT         &kp CARET     &kp AMPS      &kp STAR      &kp SEMI      &kp COLON     &none >,
//       ├─────────────┼─────────────┼─────────────┼─────────────┼─────────────┤   ├─────────────┼─────────────┼─────────────┼─────────────┼─────────────┤
<&none     &kp TAB       &kp UNDER     CT(MINUS)     CT(SQT)       &kp GRAVE         BSLH_HOME     CT(LBRC)      CT(RBRC)      PIPE_END      CT(ENTER)     &none >,
//       ├─────────────┼─────────────┼─────────────┼─────────────┼─────────────┤   ├─────────────┼─────────────┼─────────────┼─────────────┼─────────────┤
<&none     &kp TILDE     &kp EQUAL     &kp EXCL      &kp DQT       CT(PLUS)          CT(LBKT)      &kp LPAR      &kp RPAR      CT(RBKT)      &to NAVIGATE  &none >,
//       ╰─────────────┴─────────────┼─────────────┼─────────────┼─────────────┤   ├─────────────┼─────────────┼─────────────┼─────────────┴─────────────╯
<                                      &to 0         &sk LCMD      &trans            &trans        &to NUMBERS   &trans        >;
//                                   ╰─────────────┴─────────────┴─────────────╯   ╰─────────────┴─────────────┴─────────────╯
        };

        numbers_layer { // NUMBERS
            bindings = \
//       ╭─────────────┬─────────────┬─────────────┬─────────────┬─────────────╮   ╭─────────────┬─────────────┬─────────────┬─────────────┬─────────────╮
<&none     &kp ESC       &kp A         &kp B         &kp C         CT(UNDER)         CT(MINUS)     CT(N7)        CT(N8)        CT(N9)        &trans        &none >,
//       ├─────────────┼─────────────┼─────────────┼─────────────┼─────────────┤   ├─────────────┼─────────────┼─────────────┼─────────────┼─────────────┤
<&none     &kp TAB       &kp D         &kp E         &kp F         CT(PLUS)          CT(EQUAL)     CT(N4)        CT(N5)        CT(N6)        CT(ENTER)     &none >,
//       ├─────────────┼─────────────┼─────────────┼─────────────┼─────────────┤   ├─────────────┼─────────────┼─────────────┼─────────────┼─────────────┤
<&none     &to HARDWARE  &none         &none         &kp STAR      &kp DOT           CT(N0)        CT(N1)        CT(N2)        CT(N3)        &trans        &none >,
//       ╰─────────────┴─────────────┼─────────────┼─────────────┼─────────────┤   ├─────────────┼─────────────┼─────────────┼─────────────┴─────────────╯
<                                      &to 0         &sk LCMD      &trans            &trans        &none         &trans        >;
//                                   ╰─────────────┴─────────────┴─────────────╯   ╰─────────────┴─────────────┴─────────────╯
        };

        navigate_layer { // NAVIGATE
            bindings = \
//       ╭─────────────┬─────────────┬─────────────┬─────────────┬─────────────╮   ╭─────────────┬─────────────┬─────────────┬─────────────┬─────────────╮
<&none     ESC_FQUIT     &none         &none         &none         Q_H               &kp BACK      &kp PREV_TAB  &kp NEXT_TAB  &kp FORWARD   &trans        &none >,
//       ├─────────────┼─────────────┼─────────────┼─────────────┼─────────────┤   ├─────────────┼─────────────┼─────────────┼─────────────┼─────────────┤
<&none     CT(TAB)       &none         &none         &none         DEL_CTR_K         OT(LEFT)      &kp DOWN      &kp UP        OT(RIGHT)     CT(ENTER)     &none >,
//       ├─────────────┼─────────────┼─────────────┼─────────────┼─────────────┤   ├─────────────┼─────────────┼─────────────┼─────────────┼─────────────┤
<&none     CT(GRAVE)     &none         &none         &none         SPC_OPEN          &none         &none         &none         &none         &none         &none >,
//       ╰─────────────┴─────────────┼─────────────┼─────────────┼─────────────┤   ├─────────────┼─────────────┼─────────────┼─────────────┴─────────────╯
<                                      &to 0         &sk LCMD      &trans            &trans        &none         &trans        >;
//                                   ╰─────────────┴─────────────┴─────────────╯   ╰─────────────┴─────────────┴─────────────╯
        };

        hardware_layer { // HARDWARE
            bindings = \
//       ╭─────────────┬─────────────┬─────────────┬─────────────┬─────────────╮   ╭─────────────┬─────────────┬─────────────┬─────────────┬─────────────╮
<&none     &bt BT_SEL 0  &kp C_PP      &kp C_PREV    &kp C_NEXT    &none             &kp F10       &kp F7        &kp F8        &kp F9        &bt BT_CLR    &none >,
//       ├─────────────┼─────────────┼─────────────┼─────────────┼─────────────┤   ├─────────────┼─────────────┼─────────────┼─────────────┼─────────────┤
<&none     &bt BT_SEL 1  &kp C_MUTE    &kp C_VOL_DN  &kp C_VOL_UP  &none             &kp F11       &kp F4        &kp F5        &kp F6        &bt BT_SEL 3  &none >,
//       ├─────────────┼─────────────┼─────────────┼─────────────┼─────────────┤   ├─────────────┼─────────────┼─────────────┼─────────────┼─────────────┤
<&none     &bt BT_SEL 2  &kp F14       &kp F15       &kp C_BRI_UP  &kp C_BRI_DN      &kp F12       &kp F1        &kp F2        &kp F3        &bt BT_SEL 4  &none >,
//       ╰─────────────┴─────────────┼─────────────┼─────────────┼─────────────┤   ├─────────────┼─────────────┼─────────────┼─────────────┴─────────────╯
<                                      &to 0         &sk LCMD      &trans            &trans        &none         &trans        >;
//                                   ╰─────────────┴─────────────┴─────────────╯   ╰─────────────┴─────────────┴─────────────╯
        };

        blank_layer {
            bindings = \
//  0    ╭─1───────────┬─2───────────┬─3───────────┬─4───────────┬─5───────────╮   ╭─6───────────┬─7───────────┬─8───────────┬─9───────────┬─10──────────╮ 11
<&none     &trans        &trans        &trans        &trans        &trans            &trans        &trans        &trans        &trans        &trans        &none >,
//  12   ├─13──────────┼─────────────┼─────────────┼─────────────┼─────────────┤   ├─18──────────┼─────────────┼─────────────┼─────────────┼─22──────────┤
<&none     &trans        &trans        &trans        &trans        &trans            &trans        &trans        &trans        &trans        &trans        &none >,
//  24   ├─25──────────┼─────────────┼─────────────┼─────────────┼─────────────┤   ├─30──────────┼─────────────┼─────────────┼─────────────┼─34──────────┤ 35
<&none     &trans        &trans        &trans        &trans        &trans            &trans        &trans        &trans        &trans        &trans        &none >,
//       ╰─────────────┴─────────────┼─36──────────┼─37──────────┼─38──────────┤   ├─39──────────┼─40──────────┼─41──────────┼─────────────┴─────────────╯
<                                      &trans        &trans        &trans            &trans        &trans        &trans        >;
//                                   ╰─────────────┴─────────────┴─────────────╯   ╰─────────────┴─────────────┴─────────────╯
        };
    };
};
